/*  addition of the combo and behavior
 *  pray that this is working! 
 * Copyright (c) 2020 The ZMK Contributors
 *
 * SPDX-License-Identifier: MIT
 */

 #include <behaviors.dtsi>
 #include <dt-bindings/zmk/keys.h>
 #include <dt-bindings/zmk/bt.h>
 
 // Layer definitions
    #define QWERTY 1
//	  #define GAME 2
//    #define GAMEALT 3
//    #define ARROWS 4
//    #define SYMBOL 5
//    #define NUMBER 6
//    #define ARROWS_MIRROR 7
//    #define SYSTEM 8
//    #define FMWARE 9

&mt {
    flavor = "tap-preferred";
    tapping_term_ms = <200>;
};
 
 // creating a combo for pressing Tab(0) and Q(1) to make Esc
/ {
    combos {
        compatible = "zmk,combos";
		
        combo_esc {
            timeout-ms = <50>;
            key-positions = <0 1>;
            bindings = <&kp ESC>;
        };
		
// creating a combo for both pinky keys A(13) and SemiColon(22) to make Caps Word		
		combo_caps {
            timeout-ms = <50>;
            key-positions = <13 22>;
			layers = <0>
            bindings = <&caps_word>;
        };
		
// creating a combo for tapping both layer buttons at the same time to bring back to layer 0		
		combo_caps {
            timeout-ms = <50>;
            key-positions = <6 7 8>;
            bindings = <&caps_word>;
        };
    };
};
 
//creating a behavior for both pinky keys LSHIFT(?) and RSHIFT(?) to make Caps Word
/ {
// creating a behavior for the caps word
    behaviors {
        /omit-if-no-ref/ caps_word: behavior_caps_word {
            compatible = "zmk,behavior-caps-word";
            label = "CAPS_WORD";
            #binding-cells = <0>;
            continue-list = <UNDERSCORE BACKSPACE DELETE>;
         };
// creating a behavior for the backspace delete 		 
    behaviors {
        bspc_del: backspace_delete {
            compatible = "zmk,behavior-mod-morph";
            label = "BACKSPACE_DELETE";
            #binding-cells = <0>;
            bindings = <&kp BACKSPACE>, <&kp DELETE>;
            mods = <(MOD_LSFT|)>;
        };
    };
};	
	
     };
 };
 
//&mt <key1><key> - key1 will be used on HOLD, key 2 will be used on TAP

/ {
        keymap {
                compatible = "zmk,keymap";

                default_layer {
				
  //,-----------------------------------------------------.                    ,-----------------------------------------------------.
  //      TAB,       Q,       W,       E,       R,       T,                            Y,       U,       I,       O,      P,     BSPC,
  //|--------+--------+--------+--------+--------+--------|                    |--------+--------+--------+--------+--------+--------|
  //     LCTL,       A,       S,       D,       F,       G,                            H,       J,       K,       L, SEMICln,    QUOT,
  //|--------+--------+--------+--------+--------+--------|                    |--------+--------+--------+--------+--------+--------|
  //     LSFT,       Z,       X,       C,       V,       B,                            N,       M,    COMM,     DOT, fwdSLSH,     ESC,
  //|--------+--------+--------+--------+--------+--------+--------|  |--------+--------+--------+--------+--------+--------+--------|
                                      //     LGUI,Layerdwn,     SPC,        ENT, LayerUp,    RALT
                                      //`--------------------------'  `--------------------------'
                         bindings = <
  //,-----------------------------------------------------.                    ,-----------------------------------------------------.
      &kp TAB,   &kp Q,   &kp W,   &kp E,   &kp R,   &kp T,                        &kp Y,    &kpU,   &kp I,   &kp O,   &kp P,&kp BSPC,
  //|--------+--------+--------+--------+--------+--------|                    |--------+--------+--------+--------+--------+--------|
     &kp LCTL,   &kp A,   &kp S,   &kp D,   &kp F,   &kp G,                        &kp H,   &kp J,   &kp K,   &kp L,&kp SCLN,&kp QUOT,
  //|--------+--------+--------+--------+--------+--------|                    |--------+--------+--------+--------+--------+--------|
     &kp LSFT,   &kp Z,   &kp X,   &kp C,   &kp V,   &kp B,                        &kp N,   &kp M,&kp COMM, &kp DOT,&kp SLSH, &kp ESC,
  //|--------+--------+--------+--------+--------+--------+--------|  |--------+--------+--------+--------+--------+--------+--------|
                                         &kp LGUI,   &mo 1, &kp SPC,    &kp ENT,   &mo 2,&kp RALT
                                      //`--------------------------'  `--------------------------'
                        >;						
                };
                lower_layer {
					
  //,-----------------------------------------------------.                    ,-----------------------------------------------------.
  //      TAB,       Q,       W,       E,       R,       T,                            Y,       U,       I,       O,      P,     BSPC,
  //|--------+--------+--------+--------+--------+--------|                    |--------+--------+--------+--------+--------+--------|
  //     LCTL,       A,       S,       D,       F,       G,                            H,       J,       K,       L, SEMICln,    QUOT,
  //|--------+--------+--------+--------+--------+--------|                    |--------+--------+--------+--------+--------+--------|
  //     LSFT,       Z,       X,       C,       V,       B,                            N,       M,    COMM,     DOT, fwdSLSH,     ESC,
  //|--------+--------+--------+--------+--------+--------+--------|  |--------+--------+--------+--------+--------+--------+--------|
                                      //     LGUI,Layerdwn,     SPC,        ENT, LayerUp,    RALT
                                      //`--------------------------'  `--------------------------'
// delete me 									  
// -----------------------------------------------------------------------------------------
// |  TAB |  1  |  2  |  3  |  4  |  5  |   |  6  |  7  |  8  |  9  |  0  | BKSP |
// | BTCLR| BT1 | BT2 | BT3 | BT4 | BT5 |   | LFT | DWN |  UP | RGT |     |      |
// | SHFT |     |     |     |     |     |   |     |     |     |     |     |      |
//                    | GUI |     | SPC |   | ENT |     | ALT |
//format this 

                      bindings = <
  //,-----------------------------------------------------.                    ,-----------------------------------------------------.
      &kp TAB,   &kp Q,   &kp W,   &kp E,   &kp R,   &kp T,                        &kp Y,    &kpU,   &kp I,   &kp O,   &kp P,&kp BSPC,
  //|--------+--------+--------+--------+--------+--------|                    |--------+--------+--------+--------+--------+--------|
     &kp LCTL,   &kp A,   &kp S,   &kp D,   &kp F,   &kp G,                        &kp H,   &kp J,   &kp K,   &kp L,&kp SCLN,&kp QUOT,
  //|--------+--------+--------+--------+--------+--------|                    |--------+--------+--------+--------+--------+--------|
     &kp LSFT,   &kp Z,   &kp X,   &kp C,   &kp V,   &kp B,                        &kp N,   &kp M,&kp COMM, &kp DOT,&kp SLSH, &kp ESC,
  //|--------+--------+--------+--------+--------+--------+--------|  |--------+--------+--------+--------+--------+--------+--------|
                                         &kp LGUI,   &mo 1, &kp SPC,    &kp ENT,   &mo 2,&kp RALT
                                      //`--------------------------'  `--------------------------'
                        >;						
                };

                        bindings = <
   &kp TAB    &kp N1       &kp N2       &kp N3       &kp N4       &kp N5         &kp N6   &kp N7   &kp N8 &kp N9    &kp N0 &kp BSPC
   &bt BT_CLR &bt BT_SEL 0 &bt BT_SEL 1 &bt BT_SEL 2 &bt BT_SEL 3 &bt BT_SEL 4   &kp LEFT &kp DOWN &kp UP &kp RIGHT &trans &trans
   &kp LSHFT  &trans       &trans       &trans       &trans       &trans         &trans   &trans   &trans &trans    &trans &trans
                                    &kp LGUI     &trans       &kp SPACE      &kp RET  &trans   &kp RALT
                        >;
                };

                raise_layer {
										
  //,-----------------------------------------------------.                    ,-----------------------------------------------------.
  //      TAB,       Q,       W,       E,       R,       T,                            Y,       U,       I,       O,      P,     BSPC,
  //|--------+--------+--------+--------+--------+--------|                    |--------+--------+--------+--------+--------+--------|
  //     LCTL,       A,       S,       D,       F,       G,                            H,       J,       K,       L, SEMICln,    QUOT,
  //|--------+--------+--------+--------+--------+--------|                    |--------+--------+--------+--------+--------+--------|
  //     LSFT,       Z,       X,       C,       V,       B,                            N,       M,    COMM,     DOT, fwdSLSH,     ESC,
  //|--------+--------+--------+--------+--------+--------+--------|  |--------+--------+--------+--------+--------+--------+--------|
                                      //     LGUI,Layerdwn,     SPC,        ENT, LayerUp,    RALT
                                      //`--------------------------'  `--------------------------'
									  
// delete me 								  
// -----------------------------------------------------------------------------------------
// |  TAB |  !  |  @  |  #  |  $  |  %  |   |  ^  |  &  |  *  |  (  |  )  | BKSP |
// | CTRL |     |     |     |     |     |   |  -  |  =  |  [  |  ]  |  \  |  `   |
// | SHFT |     |     |     |     |     |   |  _  |  +  |  {  |  }  | "|" |  ~   |
//                    | GUI |     | SPC |   | ENT |     | ALT |
//format this 
                        bindings = <
   &kp  TAB  &kp EXCL &kp AT &kp HASH &kp DLLR &kp PRCNT   &kp CARET &kp AMPS  &kp KP_MULTIPLY &kp LPAR &kp RPAR &kp BSPC
   &kp LCTRL &trans   &trans &trans   &trans   &trans      &kp MINUS &kp EQUAL &kp LBKT        &kp RBKT &kp BSLH &kp GRAVE
   &kp LSHFT &trans   &trans &trans   &trans   &trans      &kp UNDER &kp PLUS  &kp LBRC        &kp RBRC &kp PIPE &kp TILDE
                             &kp LGUI &trans   &kp SPACE   &kp RET   &trans    &kp RALT
                        >;
                };
        };
};
